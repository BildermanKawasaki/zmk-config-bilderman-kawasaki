## config/west.yml
```yaml
manifest:
  remotes:
    - name: zmkfirmware
      url-base: https://github.com/zmkfirmware
    - name: BildermanKawasaki
      url-base: https://github.com/BildermanKawasaki
    - name: urob
      url-base: https://github.com/urob
    - name: efogdev
      url-base: https://github.com/efogdev
  projects:
    - name: zmk
      remote: zmkfirmware
      revision: main
      import: app/west.yml

      # device and drivenr modules
    - name: zmk-keyboard-totem
      remote: BildermanKawasaki 
    - name: zmk-device-adeptble-trackball
      remote: BildermanKawasaki 
    - name: zmk-pmw3610-driver
      remote: efogdev

      # urob modules
    - name: zmk-adaptive-key
      remote: urob
      path: modules/zmk/adaptive-key
    - name: zmk-auto-layer
      remote: urob
      path: modules/zmk/auto-layer
    - name: zmk-helpers
      remote: urob
      path: modules/zmk/helpers
    - name: zmk-leader-key
      remote: urob
      path: modules/zmk/leader-key
    - name: zmk-tri-state
      remote: urob
      path: modules/zmk/tri-state
    - name: zmk-unicode
      remote: urob
      path: modules/zmk/unicode
  self:
    path: config
  
```
